## vendor/libiui/configs/wasm_defconfig
```kconfig
# WebAssembly (Emscripten) build configuration
# Only WASM-specific overrides; other options inherited from Kconfig defaults

CONFIG_PORT_WASM=y
CONFIG_OPTIMIZE_SIZE=y
```
